/dts-v1/;
#include "mpfs_icicle_polarfire_u54.dts"

/ {
	compatible = "microchip,mpfs-icicle-kit", "microchip,mpfs";

	chosen {
		zephyr,console = &mmuart1;
		zephyr,shell-uart = &mmuart1;
		zephyr,sram = &sram1;
	};
};

&mmuart1 {
	status = "okay";
	current-speed = <115200>;
	clock-frequency = <150000000>;
};
