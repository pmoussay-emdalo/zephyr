## soc/microchip/miv/polarfire/Kconfig.soc
```kconfig
# RISCV64_MIV Microchip Polarfire SOC configuration options

# Copyright (c) 2020-2021 Microchip Technology Inc
# SPDX-License-Identifier: Apache-2.0

config SOC_SERIES_POLARFIRE
	bool
	select SOC_FAMILY_MICROCHIP_MIV
	help
	  Microchip RV64 implementation

config SOC_POLARFIRE
	bool
	select SOC_SERIES_POLARFIRE
	help
	  Microchip MPFS system implementation

config SOC_POLARFIRE_U54
	bool
	select SOC_POLARFIRE

config SOC_POLARFIRE_E51
	bool
	select SOC_POLARFIRE

config SOC_SERIES
	default "polarfire" if SOC_SERIES_POLARFIRE

config SOC
	default "polarfire" if SOC_POLARFIRE

# Workaround for not being able to have commas in macro arguments
DT_CHOSEN_Z_RSCTABLE_MEM := zephyr,rsctable-mem

config DT_HAS_CHOSEN_Z_RSCTABLE_MEM_ENABLED
	def_bool $(dt_chosen_enabled,$(DT_CHOSEN_Z_RSCTABLE_MEM))

config MPFS_USE_CHOSEN_RSCTABLE_MEM
	bool "Use zephyr,rsctable-mem as location for resource table"
	depends on OPENAMP_RSC_TABLE && DT_HAS_CHOSEN_Z_RSCTABLE_MEM_ENABLED
	help
	  Place resource table into a specific memory selected with the chosen node
	  zephyr,rsctable-mem
```
